## Documentation/devicetree/bindings/iio/dac/ti,dac8771.yaml
```yaml
# SPDX-License-Identifier: (GPL-2.0 OR BSD-2-Clause)
# Copyright (C) 2019 Texas Instruments Incorporated
%YAML 1.2
---
$id: "http://devicetree.org/schemas/bindings/iio/dac/ti,dac8771.yaml#"
$schema: "http://devicetree.org/meta-schemas/core.yaml#"

title: Texas Instruments DAC8771

maintainers:
  - Dan Murphy <dmurphy@ti.com>

description: |
  The DAC8771 is a single channel, precision, fully integrated 16-bit digital
  to analog converter (DAC) with adaptive power management, and is designed to
  meet the requirements of industrial control applications.

  Specifications can be found at:
    http://www.ti.com/lit/ds/symlink/dac8771.pdf

properties:
  compatible:
    enum:
      - ti,dac8771

  reg:
    maxItems: 1

  reset-gpios:
    description: |
       GPIO used for hardware reset.

  loaddacs-gpios:
    description: |
       GPIO used to shift the data from the SPI FIFO to the processing engine.

  spi-max-frequency:
    maximum: 25000000

  vref-supply:
    description: Phandle to the external reference voltage supply.

  ti,output-range:
    description: Output range of the DAC as defined in the data sheet.
       0 - Voltage output 0 to +5 V (default)
       1 - Voltage output 0 to +10 V
       2 - Voltage output ±5 V
       3 - Voltage output ±10 V
       4 - Current output 3.5 mA to 23.5 mA
       5 - Current output 0 to 20 mA
       6 - Current output 0 to 24 mA
       7 - Current output ±24 mA
       8 - Voltage output 0 to +6 V
       9 - Voltage output 0 to +12 V
       10 - Voltage output ±6 V
       11 - Voltage output ±12 V
       12 - Current output 4 mA to 20 mA
    allOf:
      - $ref: /schemas/types.yaml#/definitions/uint8
      - enum: [0, 1, 2, 3, 4, 5, 6, 7, 8, 9, 10, 11, 12]

  interrupts:
    description: IRQ line for the DAC
    maxItems: 1

required:
  - compatible
  - reg
  - vref-supply

examples:
  - |
    #include <dt-bindings/gpio/gpio.h>
    spi {
      #address-cells = <1>;
      #size-cells = <0>;
  
      dac@0 {
        compatible = "ti,dac8771";
        reg = <0>;
        spi-max-frequency = <25000000>;
        vref-supply = <&ldo3_reg>;
        ti,output-range = <2>;
        interrupts = <16>;
        interrupt-parent = <&gpio1>;
        loaddacs-gpios = <&gpio1 17 GPIO_ACTIVE_LOW>;
        reset-gpios = <&gpio1 27 GPIO_ACTIVE_LOW>;
      };
    };
```

## Documentation/devicetree/bindings/iio/health/ti,ads129x.yaml
```yaml
# SPDX-License-Identifier: (GPL-2.0 OR BSD-2-Clause)
%YAML 1.2
---
$id: http://devicetree.org/schemas/iio/adc/ti,ads129x.yaml#
$schema: http://devicetree.org/meta-schemas/core.yaml#

title: Texas Instruments ADS1298/R, ADS1296/R and ADS1294/R

maintainers:
  - Dan Murphy <dmurphy@ti.com>

description: |
  The ADS129x and ADS129xR incorporate all of the features that are commonly
  required in medical electrocardiogram (ECG) and electroencephalogram (EEG)
  applications. With high levels of integration and exceptional performance,
  the ADS129x and ADS129xR enables the development of scalable medical
  instrumentation systems at significantly reduced size, power, and cost.

  The common specification can be found at:
    ADS129x:
      http://www.ti.com/lit/gpn/ads1298

properties:
  compatible:
    enum:
      - ti,ads1294
      - ti,ads1294r
      - ti,ads1296
      - ti,ads1296r
      - ti,ads1298
      - ti,ads1298r

  reg:
    maxItems: 1

  reset-gpios:
    description:
      Reset GPIO active low.
    maxItems: 1

  interrupts:
    description:
      The interrupt line the device DRDY pin is connected to.
      For details refer to ../../interrupt-controller/interrupts.txt.

  spi-max-frequency:
      Definition as per Documentation/devicetree/bindings/spi/spi-bus.txt
  spi-cpha:
      Definition as per	Documentation/devicetree/bindings/spi/spi-bus.txt

required:
  - compatible
  - reg
  - spi-cpha

examples:
  - |
    #include <dt-bindings/gpio/gpio.h>
    ads129x@0 {
         compatible = "ti,ads1298";
         reg = <0>;
         spi-max-frequency = <100000>;
         spi-cpha;
         interrupt-parent = <&gpio1>;
         interrupts = <16 IRQ_TYPE_EDGE_RISING>;
         reset-gpios = <&gpio1 27 GPIO_ACTIVE_LOW>;
    };
```

## Documentation/devicetree/bindings/net/ti,dp83td510.yaml
```yaml
# SPDX-License-Identifier: (GPL-2.0-only OR BSD-2-Clause)
# Copyright (C) 2020 Texas Instruments Incorporated
%YAML 1.2
---
$id: "http://devicetree.org/schemas/net/ti,dp83td510.yaml#"
$schema: "http://devicetree.org/meta-schemas/core.yaml#"

title: TI DP83TD510 ethernet PHY

allOf:
  - $ref: "ethernet-controller.yaml#"
  - $ref: "ethernet-phy.yaml#"

maintainers:
  - Dan Murphy <dmurphy@ti.com>

description: |
  The PHY is an twisted pair 10Mbps Ethernet PHY that support MII, RMII and
  RGMII interfaces.

  Specifications about the Ethernet PHY can be found at:
    http://www.ti.com/lit/ds/symlink/dp83td510e.pdf

properties:
  reg:
    maxItems: 1

  tx-fifo-depth:
    description: |
       Transmitt FIFO depth for RMII mode.  The PHY only exposes 4 nibble
       depths. The valid nibble depths are 4, 5, 6 and 8.
    enum: [ 4, 5, 6, 8 ]
    default: 5

  rx-internal-delay-ps:
    description: |
       Setting this property to a non-zero number sets the RX internal delay
       for the PHY.  The internal delay for the PHY is fixed to 30ns relative
       to receive data.

  tx-internal-delay-ps:
    description: |
       Setting this property to a non-zero number sets the TX internal delay
       for the PHY.  The internal delay for the PHY has a range of -4 to 4ns
       relative to transmit data.

unevaluatedProperties: false

required:
  - reg

examples:
  - |
    mdio0 {
      #address-cells = <1>;
      #size-cells = <0>;
      ethphy0: ethernet-phy@0 {
        reg = <0>;
        tx-rx-output-high;
        tx-fifo-depth = <5>;
        rx-internal-delay-ps = <1>;
        tx-internal-delay-ps = <1>;
      };
    };
```

## Documentation/devicetree/bindings/power/supply/bq256xx.yaml
```yaml
# SPDX-License-Identifier: (GPL-2.0 OR BSD-2-Clause)
# Copyright (C) 2020 Texas Instruments Incorporated
%YAML 1.2
---
$id: "http://devicetree.org/schemas/power/supply/bq256xx.yaml#"
$schema: "http://devicetree.org/meta-schemas/core.yaml#"

title: TI bq256xx Switch Mode Buck Charger

maintainers:
  - Ricardo Rivera-Matos <r-rivera-matos@ti.com>

description: |
  The bq256xx is a family of highly-integrated battery charge management and
  system power management devices for single cell Li-ion and Li-Po batteries.

  Datasheets:
    - http://www.ti.com/lit/ds/symlink/bq25600.pdf
    - http://www.ti.com/lit/ds/symlink/bq25601.pdf
    - http://www.ti.com/lit/ds/symlink/bq25600d.pdf
    - http://www.ti.com/lit/ds/symlink/bq25601d.pdf
    - http://www.ti.com/lit/ds/symlink/bq25611d.pdf
    - http://www.ti.com/lit/ds/symlink/bq25618.pdf
    - http://www.ti.com/lit/ds/symlink/bq25619.pdf

properties:
  compatible:
    enum:
      - ti,bq25600
      - ti,bq25601
      - ti,bq25600d
      - ti,bq25601d
      - ti,bq25611d
      - ti,bq25618
      - ti,bq25619

  reg:
    maxItems: 1

  watchdog-timer:
    description: |
      Watchdog timer in milli seconds. 0 (default) disables the watchdog.
    minimum: 0
    maximum: 160000
    enum: [ 0, 40000, 80000, 160000]

  input-voltage-limit-microvolt:
    description: |
       Minimum input voltage limit in micro volts with a 100000 micro volt step.
    minimum: 3900000
    maximum: 5400000

  input-current-limit-microamp:
    description: |
       Maximum input current limit in micro amps with a 100000 micro amp step.
    minimum: 100000
    maximum: 3200000

required:
  - compatible
  - reg

examples:
  - |
    bat: battery {
      compatible = "simple-battery";
      constant-charge-current-max-microamp = <2040000>;
      constant-charge-voltage-max-microvolt = <4352000>;
      precharge-current-microamp = <180000>;
      termination-current-microamp = <180000>;
    };
    #include <dt-bindings/gpio/gpio.h>
    #include <dt-bindings/interrupt-controller/irq.h>
    i2c0 {
      pinctrl-names = "default";
      pinctrl-0 = <&i2c2_pins>;

      status = "okay";
      clock-frequency = <400000>;

      #address-cells = <1>;
      #size-cells = <0>;

      bq25601@6b {
       	compatible = "ti,bq25601";
       	reg = <0x6b>;
        monitored-battery = <&bat>;

        interrupt-parent = <&gpio1>;
        interrupts = <16 IRQ_TYPE_EDGE_FALLING>;
        watchdog-timer = <2000>;

        input-voltage-limit-microvolt = <4500000>;
        input-current-limit-microamp = <2400000>;
      };
    };
```

## Documentation/devicetree/bindings/power/supply/bq25790.yaml
```yaml
# SPDX-License-Identifier: (GPL-2.0 OR BSD-2-Clause)
# Copyright (C) 2020 Texas Instruments Incorporated
%YAML 1.2
---
$id: "http://devicetree.org/schemas/power/supply/bq25790.yaml#"
$schema: "http://devicetree.org/meta-schemas/core.yaml#"

title: TI bq25790 Switch Mode Buck-Boost Charger

maintainers:
  - Dan Murphy <dmurphy@ti.com>
  - Ricardo Rivera-Matos <r-rivera-matos@ti.com>

description: |
  BQ25790 is a highly integrated switch-mode buckboost charger for 1-4 cell Li-
  ion battery and Lipolymer battery.

properties:
  compatible:
    enum:
      - ti,bq25790

  reg:
    maxItems: 1

  watchdog-timer:
    description: |
       Watchdog timer in milli seconds. 0 (default) disables the watchdog.
    minimum: 0
    maximum: 160000
    enum: [ 0, 500, 1000, 2000, 20000, 40000, 80000, 160000 ]

  input-voltage-limit-microvolt:
    description: |
       Minimum input voltage limit in micro volts with a 100000 micro volt step.
    minimum: 3600000
    maximum: 22000000

  input-current-limit-microamp:
    description: |
       Maximum input current limit in micro amps with a 100000 micro amp step.
    minimum: 100000
    maximum: 3300000

required:
  - compatible
  - reg

additionalProperties: false

examples:
  - |
    bat: battery {
      compatible = "simple-battery";
      constant-charge-current-max-microamp = <1000000>;
      precharge-current-microamp = <120000>;
      constant-charge-voltage-max-microvolt = <4200000>;
      termination-current-microamp = <180000>;
    };
    #include <dt-bindings/interrupt-controller/irq.h>
    #include <dt-bindings/gpio/gpio.h>
    i2c2 {
      pinctrl-names = "default";
      pinctrl-0 = <&i2c2_pins>;

      status = "okay";
      clock-frequency = <400000>;

      #address-cells = <1>;
      #size-cells = <0>;

      charger@6b {
          compatible = "ti,bq25790";
          reg = <0x6b>;
          interrupts = <0 IRQ_TYPE_LEVEL_LOW>;
          interrupt-parent = <&gpio1>;
          watchdog-timer = <2000>;
      };
    };
```
